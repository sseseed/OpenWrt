## build_dir/target-arm_cortex-a7+neon-vfpv4_musl_eabi/linux-ipq40xx_generic/tmp/openwrt-ipq40xx-generic-rrys_le1-initramfs-fit-zImage.itb.its
```
/dts-v1/;

/ {
	description = "ARM OpenWrt FIT (Flattened Image Tree)";
	#address-cells = <1>;

	images {
		kernel-1 {
			description = "ARM OpenWrt Linux-5.10.146";
			data = /incbin/("/home/sse/home/openwrt-22.03.2/build_dir/target-arm_cortex-a7+neon-vfpv4_musl_eabi/linux-ipq40xx_generic/tmp/openwrt-ipq40xx-generic-rrys_le1-initramfs-fit-zImage.itb");
			type = "kernel";
			arch = "arm";
			os = "linux";
			compression = "none";
			load = <0x80208000>;
			entry = <0x80208000>;
			hash@1 {
				algo = "crc32";
			};
			hash@2 {
				algo = "sha1";
			};
		};


		fdt-1 {
			description = "ARM OpenWrt rrys_le1 device tree blob";
			
			data = /incbin/("/home/sse/home/openwrt-22.03.2/build_dir/target-arm_cortex-a7+neon-vfpv4_musl_eabi/linux-ipq40xx_generic/linux-5.10.146/arch/arm/boot/dts/qcom-ipq4019-le1.dtb");
			type = "flat_dt";
			
			arch = "arm";
			compression = "none";
			hash@1 {
				algo = "crc32";
			};
			hash@2 {
				algo = "sha1";
			};
		};



	};

	configurations {
		default = "config@1";
		config@1 {
			description = "OpenWrt rrys_le1";
			kernel = "kernel-1";
			fdt = "fdt-1";
			
			
			
		};
		
	};
};
```
